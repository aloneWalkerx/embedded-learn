#include "./SYSTEM/sys/sys.h"
#include "./SYSTEM/delay/delay.h"
#include "./SYSTEM/usart/usart.h"
#include "./MALLOC/malloc.h"
#include "./FATFS/exfuns/exfuns.h"
#include "./BSP/LED/led-i.h"
#include "./BSP/KEY/key-i.h"
#include "./BSP/LCD/lcd.h"
#include "./BSP/SD/sdcard.h"
#include "./TEXT/text.h"
#include "./USMART/usmart.h"
/*
 * ============================================================================
 * 主函数
 * ============================================================================
 * 功能流程：
 *   1. 初始化硬件（时钟、延时、串口、LED、按键、LCD、内存池）
 *   2. 挂载文件系统（SD卡 "0:"、NOR Flash "1:"）
 *   3. 检查字库是否存在（fonts_init）
 *      - 如果字库不存在或损坏 → 从SD卡更新字库到NOR Flash
 *   4. 在LCD上显示固定提示信息
 *   5. 进入主循环：遍历所有GBK汉字（0x81~0xFE × 0x40~0xFE）
 *      - 在LCD上显示当前汉字的内码和点阵
 *      - 支持按键中断跳转到字库更新
 * ============================================================================
 */
int main(void)
{
    uint8_t t = 0;                         // 临时延时计数器
    uint8_t key;                           // 按键值（用于检测WKUP按键）
    uint8_t res;                           // 函数返回值（用于字库更新）
    uint32_t fontcnt;                      // 汉字计数器（记录已显示的汉字数量）
    uint8_t i;                             // GBK内码高字节循环变量（0x81~0xFE）
    uint8_t j;                             // GBK内码低字节循环变量（0x40~0xFE）
    uint8_t fontx[2];                      // 存放当前汉字的GBK内码（2字节）
    
    /*
     * ========================================================================
     * 【第一阶段】硬件初始化
     * ========================================================================
     */
    HAL_Init();                         /* 初始化HAL库（必须最先调用） */
    sys_stm32_clock_init(336, 8, 2, 7); /* 配置系统时钟为168MHz（PLL: 8M/8*336/2=168M） */
    delay_init(168);                    /* 初始化延时函数（参数为系统主频168MHz） */
    usart_init(115200);                 /* 初始化串口1，波特率115200（用于printf调试） */
    led_i_init();                       /* 初始化LED（LED0对应PF9） */
    key_i_init();                       /* 初始化按键（WKUP/KEY0/KEY1） */
    lcd_init();                         /* 初始化LCD屏幕（2.8/3.5/4.3寸MCU屏） */
    my_mem_init(SRAMIN);                /* 初始化内部SRAM内存池（100KB，用于动态内存分配） */
    my_mem_init(SRAMCCM);               /* 初始化CCM内存池（60KB，仅CPU可访问） */
    exfuns_init();                      /* 为exfuns申请内存（fs[0]和fs[1]文件系统对象） */
    f_mount(fs[0], "0:", 1);            /* 挂载SD卡到盘符 "0:"（1表示立即挂载） */
    f_mount(fs[1], "1:", 1);            /* 挂载NOR Flash到盘符 "1:" */
    usmart_dev.init(84);                /* 初始化USMART */
    /*
     * ========================================================================
     * 【第二阶段】字库检查与更新
     * ========================================================================
     * fonts_init() 返回值说明：
     *   0 → 字库正常（NOR Flash中的ftinfo.fontok == 0xAA）
     *   1 → 字库不存在或损坏，需要更新
     * ========================================================================
     */
    while (fonts_init() != 0)           // 如果字库初始化失败，进入更新流程
    {
UPD:                                    // ① 跳转标签（WKUP按键按下时跳转到这里）
        lcd_clear(WHITE);               // 清屏（白色背景）
        lcd_show_string(30, 30, 200, 16, 16, "STM32", RED);  // 显示标题

        /*
         * 【步骤1】初始化SD卡
         * SD卡中存放了字库文件（/SYSTEM/FONT/UNIGBK.BIN, GBK12.FON, GBK16.FON, GBK24.FON）
         * 必须成功初始化才能读取字库文件
         */
        while (sd_init() != 0)          // 如果SD卡初始化失败，循环提示
        {
            lcd_show_string(30, 30, 200, 16, 16, "SD Card Error!", RED);
            delay_ms(500);
            lcd_show_string(30, 30, 200, 16, 16, "Please Check! ", RED);
            delay_ms(500);
            LED0_TOGGLE();              // LED0翻转，指示错误状态
        }

        /* SD卡初始化成功 */
        lcd_show_string(30, 50, 200, 16, 16, "SD Card OK", RED);
        lcd_show_string(30, 70, 200, 16, 16, "Font Updating...", RED);

        /*
         * 【步骤2】从SD卡更新字库到NOR Flash
         * fonts_update_font(30, 90, 16, "0:", RED)
         *   参数1: X坐标起始位置
         *   参数2: Y坐标起始位置
         *   参数3: 进度提示文字大小
         *   参数4: 字库来源路径 "0:"（SD卡）
         *   参数5: 文字颜色
         *
         * 该函数会依次读取SD卡中的4个字库文件，写入NOR Flash
         * 执行时间较长（约10-30秒），期间LCD会显示进度百分比
         */
        res = fonts_update_font(30, 90, 16, (uint8_t *)"0:", RED);

        /* 如果字库更新失败，循环提示 */
        while (res != 0)
        {
            lcd_show_string(30, 90, 200, 16, 16, "Font Update Failed!", RED);
            delay_ms(200);
            lcd_show_string(30, 90, 200, 16, 16, "Please Check!      ", RED);
            delay_ms(200);
        }

        /* 字库更新成功 */
        lcd_show_string(30, 90, 200, 16, 16, "Font Update Success!   ", RED);
        delay_ms(1500);                 // 延时1.5秒，让用户看到成功信息
        lcd_clear(WHITE);               // 清屏，准备进入主界面

        /* 此时 while (fonts_init() != 0) 循环条件不满足，自动退出循环 */
    }

    /*
     * ========================================================================
     * 【第三阶段】显示固定提示信息（LCD主界面布局）
     * ========================================================================
     * 在屏幕上划分区域：
     *   - 行30~90： 标题信息
     *   - 行110~150：内码显示区（显示当前汉字的高字节、低字节和计数）
     *   - 行180~240：点阵显示区（显示当前汉字的12/16/24号点阵）
     * ========================================================================
     */
    text_show_string(30, 30, 200, 16, "正点原子STM32开发板", 16, 0, RED);
    text_show_string(30, 50, 200, 16, "GBK字库测试程序", 16, 0, RED);
    text_show_string(30, 70, 200, 16, "ALONE@WALKER", 16, 0, RED);
    text_show_string(30, 90, 200, 16, "WKUP: 更新字库", 16, 0, RED);

    /* 内码显示区标签 */
    text_show_string(30, 110, 200, 16, "内码高字节:", 16, 0, BLUE);
    text_show_string(30, 130, 200, 16, "内码低字节:", 16, 0, BLUE);
    text_show_string(30, 150, 200, 16, "汉字计数器:", 16, 0, BLUE);

    /* 点阵显示区标签 */
    text_show_string(30, 180, 200, 24, "对应汉字为:", 24, 0, BLUE);
    text_show_string(30, 204, 200, 16, "对应汉字(16*16)为:", 16, 0, BLUE);
    text_show_string(30, 220, 200, 12, "对应汉字(12*12)为:", 12, 0, BLUE);

    /*
     * ========================================================================
     * 【第四阶段】主循环：遍历显示所有GBK汉字
     * ========================================================================
     * GBK编码范围：
     *   高字节（区号）：0x81 ~ 0xFE（共126个区）
     *   低字节（位号）：0x40 ~ 0xFE，跳过0x7F（每区190个汉字）
     *   总计：126 × 190 = 23,940 个汉字
     *
     * 循环过程中，LCD会逐个显示每个汉字的：
     *   - 内码高字节（3位十六进制，如 0x81）
     *   - 内码低字节（3位十六进制，如 0x40）
     *   - 当前已显示的汉字数量
     *   - 该汉字的24×24、16×16、12×12 三种点阵显示
     * ========================================================================
     */
    while (1)
    {
        fontcnt = 0;                    // 重置汉字计数器

        /* 外层循环：GBK高字节（区号） 0x81 ~ 0xFE */
        for (i = 0x81; i < 0xFF; i++)
        {
            fontx[0] = i;               // 存储当前高字节
            lcd_show_num(118, 110, i, 3, 16, BLUE);  // 在LCD上显示高字节数值

            /* 内层循环：GBK低字节（位号） 0x40 ~ 0xFE */
            for (j = 0x40; j < 0xFE; j++)
            {
                /* GBK编码中 0x7F 是保留位，不是有效的汉字编码，跳过 */
                if (j == 0x7F)
                {
                    continue;           // 跳过 0x7F，继续下一个
                }

                fontcnt++;              // 有效汉字计数器+1

                /* 更新LCD显示区 */
                lcd_show_num(118, 130, j, 3, 16, BLUE);      // 显示低字节
                lcd_show_num(118, 150, fontcnt, 5, 16, BLUE); // 显示计数器
                fontx[1] = j;           // 存储当前低字节（组成完整GBK内码）

                /*
                 * 在LCD的三个区域分别显示当前汉字的24×24、16×16、12×12点阵
                 * 位置偏移：让三个点阵从右到左排列，互不重叠
                 */
                text_show_font(30 + 132, 180, fontx, 24, 0, BLUE);  // 24×24点阵（最大）
                text_show_font(30 + 144, 204, fontx, 16, 0, BLUE);  // 16×16点阵（中等）
                text_show_font(30 + 108, 220, fontx, 12, 0, BLUE);  // 12×12点阵（最小）

                /*
                 * 【延时与按键检测】
                 * 每个汉字显示约200ms，方便肉眼观察
                 * 同时检测WKUP按键，如果按下则跳转到字库更新流程
                 */
                t = 200;                // 设置延时计数
                while ((t--) != 0)
                {
                    delay_ms(1);        // 延时1ms，共200ms

                    key = key_i_scan(0); // 扫描按键（0表示不连续按下）
                    if (key == WKUP_PRESS)  // 如果WKUP按键被按下（长按）
                    {
                        /* 跳转到字库更新标签，重新更新字库 */
                        goto UPD;       // ② 跳转到字库更新流程（前面定义的标签）
                    }
                }

                LED0_TOGGLE();          // 每显示一个汉字，LED0翻转一次
            } /* 内层循环结束（低字节） */
        } /* 外层循环结束（高字节） */

        /*
         * 所有GBK汉字遍历完毕（23940个汉字已全部显示）
         * 循环会自动回到 while(1) 开头，从头开始再次遍历
         */
    }
}

